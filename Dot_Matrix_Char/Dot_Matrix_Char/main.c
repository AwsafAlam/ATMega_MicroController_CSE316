#include <avr/io.h>
#define F_CPU 1000000UL
#include <util/delay.h>

//int temp[8];

static int CHAR_ARRAY[26][8]={{0, //A
	0b01111111,
	0b11111111,
	0b11001100,
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	0b11111111},//z

{
	0b11000011,
	0b11100011,
	0b11110011,
	0b11111011,
	0b11011111,
	0b11001111,
	0b11000111,
	0b11000011}};//characters a,b,c,d,e,f,g,...z binary codecs

void rotate90(int idx)
{
	int b[8] ;
	int n = 8 ;
	for(int i=0 ; i<8 ; i++) b[i] =0 ;
	
	for(int i=0 ; i<8 ;i++)
	{
		for(int j=0 ; j<8 ; j++)
		{
			if( ( CHAR_ARRAY[idx][i]&(1<<j))!=0 ) b[ n-j-1 ] |= (1<<i) ;
		}
	}
	for(int i=0 ; i<8 ; i++) CHAR_ARRAY[idx][i] = b[i]  ;
}

void LeftRotate(int idx)
{
	rotate90(idx) ;
}

void RightRotate(int idx)
{
     rotate90(idx) ;
	 rotate90(idx) ;
	 rotate90(idx) ;
}

void ScrollRight(int idx){
	for(int j = 7 ; j>=1 ; j--){
		
		CHAR_ARRAY[11][j] = CHAR_ARRAY[11][j-1];
		CHAR_ARRAY[11][0] = 0;
		
	}
}

void wrap(int idx)
{	 
	int temp = CHAR_ARRAY[idx][0] ;
	for(int j=1 ; j<=7 ; j++){
		
		 CHAR_ARRAY[idx][j-1] = CHAR_ARRAY[idx][j] ;
	}
	CHAR_ARRAY[idx][7] = temp ;	 
} 

int main(void)

{
	MCUCSR = (1<<JTD);  MCUCSR = (1<<JTD);

	DDRA = 0xFF;//PORTB,C,D are set as output

	DDRC = 0xFF;

	//char PORT[8] = {1,2,4,8,16,32,64,128};//pin values of PORTA
	//CHAR_ARRAY[24][0] = 0x00;
	int hId = 0 ;
	while(1)

	{
			for (int n=0;n<200;n++)//execute 200 times for the eye to catch

			{

				for (int j=0;j<8;j++)
				{
					//int t=j;
					 PORTA = (1<<(j)) ; // ROW ,sets the j'th bit
				 

					PORTC = CHAR_ARRAY[24][j] & 0b01111111;//show  character (COLUMN)
					//temp=(8-(temp+1))%8;
					
					_delay_us(500);


				}
				//PORTA=0x00;//clear screen after show.

			}

		PORTA=0x00;
		//_delay_ms(800);
		wrap(24); hId = (hId+7)%8 ; 

		}
	//	temp=(temp-1+8)%8;

}

